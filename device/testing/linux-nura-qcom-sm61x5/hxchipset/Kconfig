## device/testing/linux-nura-qcom-sm61x5/hxchipset/Kconfig
```kconfig
config TOUCHSCREEN_HIMAX_CHIPSET
	bool "Himax HX83102D touchscreen"
	depends on INPUT && SPI && GPIOLIB && OF
	select INPUT_MT
	select FW_LOADER

config TOUCHSCREEN_HIMAX_COMMON
	bool
	default y if TOUCHSCREEN_HIMAX_CHIPSET

config TOUCHSCREEN_HIMAX_INCELL
	bool
	depends on TOUCHSCREEN_HIMAX_COMMON
	default y if TOUCHSCREEN_HIMAX_CHIPSET

config TOUCHSCREEN_HIMAX_IC_HX83102
	bool
	depends on TOUCHSCREEN_HIMAX_INCELL
	default y if TOUCHSCREEN_HIMAX_CHIPSET
```
